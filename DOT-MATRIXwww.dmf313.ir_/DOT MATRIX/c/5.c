#include <mega16.h>
#include <delay.h>

char image[8];
char data[48]=
{
    0x00,    //  0001        . . . . . . . . 
    0x00,    //  0002        . . . . . . . . 
    0x00,    //  0003        . . . . . . . . 
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	0x5D,	//	0047		. # . # # # . # 
	0x7C 	//	0048		. # # # # # . .    
};

char faal_saz[8]={254,253,251,247,239,223,191,127};


void main(void)
{
    unsigned int i=0,timer=0,chars=0,j=0;
    
    DDRA=0xFF;
    DDRB=0xFF;
    
    while (1)
    {
        for(chars=0;chars<=5;chars++)//نمايش کاراکتر ها
        { 
            for(j=chars*8;j<=chars*8+7;j++)
                image[j]=data[j];

            for(timer=0;timer<=5;timer++)
                for(i=0;i<=7;i++)
                {            
                    PORTA=image[i];
                    PORTB=faal_saz[i];
                    delay_ms(5);
                    PORTA=0;PORTB=255;
                }
        }
    }
}
#include <mega16.h>
#include <delay.h>

char image[8];
char data[48]=
{
    0x00,    //  0001        . . . . . . . . 
    0x00,    //  0002        . . . . . . . . 
    0x00,    //  0003        . . . . . . . . 
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	0x5D,	//	0047		. # . # # # . # 
	0x7C 	//	0048		. # # # # # . .    
};

char faal_saz[8]={0B11111110,0B11111101,0B11111011,0B11110111,0B11101111,0B11011111,0B10111111,0B01111111,};


void main(void)
{
    unsigned int i=0,timer=0,number_char=0,j=0;
    
    DDRA=0xFF;
    DDRB=0xFF;
    
    while (1)
    {
        for(number_char=0;number_char<=5;number_char++)
        { 
            if(number_char==0)     for(j=0;j<=7;j++)  image[j]=data[j];
            else if(number_char==1)for(j=8;j<=15;j++) image[j]=data[j];
            else if(number_char==2)for(j=16;j<=23;j++)image[j]=data[j];
            else if(number_char==3)for(j=24;j<=31;j++)image[j]=data[j];
            else if(number_char==4)for(j=32;j<=39;j++)image[j]=data[j];
            else if(number_char==5)for(j=40;j<=47;j++)image[j]=data[j];
            
                    
            for(timer=0;timer<=4;timer++)
                for(i=0;i<=7;i++)
                {            
                    PORTA=image[i];
                    PORTB=faal_saz[i];
                    delay_ms(5);
                    PORTA=0;PORTB=255;
                }
        }
    }
}